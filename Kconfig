## Kconfig.projbuild
```kconfig
menu "Project Configuration"

    menu "GECL Time Sync Manager Configuration"
    config GECL_TIME_SYNC_MANAGER_ENABLED
        bool "Enable Time Sync Manager"
        default y
    
    config GECL_TIME_SYNC_MANAGER_SYNC_INTERVAL
        int "Time Sync Interval (seconds)"
        default 3600
        depends on GECL_TIME_SYNC_MANAGER_ENABLED
    endmenu
    
    menu "GECL Logger Manager Configuration"
    config GECL_LOGGER_MANAGER_ENABLED
        bool "Enable Logger Manager"
        default y
    
    config GECL_LOGGER_MANAGER_LOG_LEVEL
        int "Logger Manager Log Level"
        default 3
        depends on GECL_LOGGER_MANAGER_ENABLED
    endmenu
    
    menu "GECL OTA Manager Configuration"
    config GECL_OTA_MANAGER_ENABLED
        bool "Enable OTA Manager"
        default y
    
    config GECL_OTA_MANAGER_UPDATE_INTERVAL
        int "OTA Update Interval (seconds)"
        default 86400
        depends on GECL_OTA_MANAGER_ENABLED
    endmenu
    
    endmenu
    
```
